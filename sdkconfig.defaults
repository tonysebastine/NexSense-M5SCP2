## sdkconfig.defaults
```kconfig
# =============================================================================
# NexSense M5-DoorSensor - sdkconfig.defaults
# Target: M5StickC Plus 2 (ESP32-PICO-V3-02)
# =============================================================================

# --- Target ---
CONFIG_IDF_TARGET="esp32"

# --- Flash ---
CONFIG_ESPTOOLPY_FLASHSIZE_8MB=y
CONFIG_ESPTOOLPY_FLASHFREQ_80M=y
CONFIG_ESPTOOLPY_FLASHMODE_QIO=y

# --- PSRAM ---
CONFIG_ESP32_SPIRAM_SUPPORT=y
CONFIG_SPIRAM_MODE_QUAD=y
CONFIG_SPIRAM_SPEED_80MHZ=y

# --- Partition Table ---
CONFIG_PARTITION_TABLE_CUSTOM=y
CONFIG_PARTITION_TABLE_CUSTOM_FILENAME="partitions.csv"

# --- CPU ---
CONFIG_ESP_DEFAULT_CPU_FREQ_MHZ_240=y

# --- Bluetooth (NimBLE) ---
CONFIG_BT_ENABLED=y
CONFIG_BT_NIMBLE_ENABLED=y
CONFIG_BT_CONTROLLER_ENABLED=y
CONFIG_BT_BLUEDROID_ENABLED=n
CONFIG_BT_NIMBLE_MAX_CONNECTIONS=1
CONFIG_BT_NIMBLE_ROLE_CENTRAL=n
CONFIG_BT_NIMBLE_ROLE_OBSERVER=n
CONFIG_BT_NIMBLE_ROLE_PERIPHERAL=y
CONFIG_BT_NIMBLE_ROLE_BROADCASTER=y
CONFIG_BT_NIMBLE_NVS_PERSIST=n

# --- NVS ---
CONFIG_NVS_ENCRYPTION=n

# --- Power Management ---
CONFIG_PM_ENABLE=y
CONFIG_FREERTOS_USE_TICKLESS_IDLE=y
CONFIG_FREERTOS_IDLE_TIME_BEFORE_SLEEP=3

# --- Logging (reduce for production) ---
CONFIG_LOG_DEFAULT_LEVEL_INFO=y
CONFIG_LOG_MAXIMUM_LEVEL_DEBUG=y

# --- Watchdog ---
CONFIG_ESP_TASK_WDT_TIMEOUT_S=30

# --- mbedTLS (for AES-CCM) ---
CONFIG_MBEDTLS_CCM_C=y
CONFIG_MBEDTLS_AES_C=y

# --- WiFi (disabled by default, Phase 3) ---
CONFIG_ESP_WIFI_ENABLED=n
```
